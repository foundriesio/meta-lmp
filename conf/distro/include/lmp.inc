## meta-lmp-base/conf/distro/lmp-base.conf
```bitbake
require conf/distro/include/lmp.inc

DISTRO = "lmp-base"
DISTROOVERRIDES = "lmp:lmp-base"
DISTRO_NAME = "Linux-microPlatform Base (no ostree)"

IMAGE_LINGUAS ?= "en-us"

INITRAMFS_FSTYPES = "cpio.gz"

# By default we don't have any extra machine dependencies
MACHINE_ESSENTIAL_EXTRA_RDEPENDS = ""

# Facilitate kernel development by removing modsign by default
DISTRO_FEATURES_DEFAULT:remove = "modsign"

# Facilitate debugging
DISTRO_FEATURES_DEFAULT:append = " minidebuginfo debuginfod lmpdebug"

INITRD_IMAGE_LIVE ?= ""
```

## meta-lmp-base/conf/distro/lmp-mfgtool.conf
```bitbake
DISTRO = "lmp-mfgtool"
DISTROOVERRIDES = "lmp:lmp-mfgtool"
DISTRO_NAME = "Linux-microPlatform for Mfgtool (no ostree)"

IMAGE_LINGUAS ?= "en-us"

# By default we only support initramfs. We don't build live as that
# pulls in a lot of dependencies for the live image and the installer, like
# udev, grub, etc.  These pull in gettext, which fails to build with wide
# character support.
IMAGE_FSTYPES = "cpio.gz"
QB_DEFAULT_FSTYPE = "${IMAGE_FSTYPES}"

# By default we don't have any extra machine dependencies
MACHINE_ESSENTIAL_EXTRA_RDEPENDS = ""

# Common settings across imx devices
INITRAMFS_IMAGE ?= "fsl-image-mfgtool-initramfs"
PREFERRED_PROVIDER_virtual/optee-os ?= "optee-os-fio-mfgtool"

# Base settings from LMP
require conf/distro/include/lmp.inc

# Machine specific overrides
include conf/machine/include/lmp-mfgtool-machine-custom.inc

# Partner specific overrides
include conf/machine/include/lmp-mfgtool-partner-custom.inc

# Factory specific overrides
include conf/machine/include/lmp-mfgtool-factory-custom.inc

# Compatibility with other layers
#DISTRO_FEATURES:remove = "modsign"
# WARNING: You have included the meta-integrity layer, but 'integrity' has not been enabled in your DISTRO_FEATURES. Some bbappend files and preferred version setting may not take effect. See the meta-integrity README for details on enabling integrity support.
DISTRO_FEATURES:remove = "integrity"
```

## meta-lmp-base/conf/distro/lmp-wayland.conf
```bitbake
require conf/distro/lmp.conf

DISTRO = "lmp-wayland"
DISTROOVERRIDES = "lmp:lmp-wayland"
DISTRO_NAME = "Linux-microPlatform Wayland"

DISTRO_FEATURES:append = " wayland opengl"
```

## meta-lmp-base/conf/distro/lmp-xwayland.conf
```bitbake
require conf/distro/lmp.conf

DISTRO = "lmp-xwayland"
DISTROOVERRIDES = "lmp:lmp-wayland:lmp-xwayland"
DISTRO_NAME = "Linux-microPlatform XWayland"

DISTRO_FEATURES:append = " x11 wayland opengl vulkan"
```

## meta-lmp-base/conf/distro/lmp.conf
```bitbake
require conf/distro/include/lmp.inc

DISTRO = "lmp"
DISTRO_NAME = "Linux-microPlatform"

IMAGE_LINGUAS ?= "en-us"

# SOTA
OSTREE_OSNAME = "lmp"
INITRAMFS_IMAGE = "initramfs-ostree-lmp-image"
INITRAMFS_FSTYPES = "cpio.gz"
OSTREE_KERNEL ?= "${@oe.utils.conditional('KERNEL_IMAGETYPE', 'fitImage', '${KERNEL_IMAGETYPE}-${INITRAMFS_IMAGE}-${MACHINE}-${KERNEL_FIT_LINK_NAME}', '${KERNEL_IMAGETYPE}', d)}"
OSTREE_KERNEL_ARGS_COMMON ?= "root=LABEL=otaroot rootfstype=ext4"
OSTREE_KERNEL_ARGS ?= "${OSTREE_KERNEL_ARGS_COMMON}"
OSTREE_SPLIT_BOOT ?= "0"
OSTREE_LOADER_LINK ?= "1"
OSTREE_DEPLOY_USR_OSTREE_BOOT ?= "0"
DISTRO_FEATURES:append = " sota"
DISTRO_FEATURES_NATIVE:append = " sota"
INHERIT += "sota"
## No need to install the kernel image into the boot partition
IMAGE_BOOT_FILES:remove = " ${KERNEL_IMAGETYPE}"
## Prefer aktualizr-lite as the default SOTA_CLIENT
SOTA_CLIENT ?= "aktualizr-lite"
## Disable default prov by default to allow runtime configuration
SOTA_CLIENT_PROV ?= ""
## Also produce OTA rootfs tarball for additional image support
BUILD_OTA_TARBALL = "1"
## Support Aktualizr with HSM by default for secure SOTA
SOTA_CLIENT_FEATURES:append = " hsm"
## Sota BSP specific configs are managed by LMP
SOTA_MACHINE:lmp = "lmp"
## Allow custom SOTA_CLIENT providers (e.g. aktualizr-lite)
IMAGE_INSTALL:append = " ${@oe.utils.ifelse('${SOTA_CLIENT}' != 'aktualizr', '${SOTA_CLIENT}', '')}"
IMAGE_INSTALL:remove = "${@oe.utils.ifelse('${SOTA_CLIENT}' != 'aktualizr', 'aktualizr aktualizr-info', '')}"
## Do not ship repo manifest in /etc by default (published by CI instead)
IMAGE_CLASSES:remove = "image_repo_manifest"
## No need for fstab update as it is available via the ostree rootfs
WIC_CREATE_EXTRA_ARGS:sota:append = " --no-fstab-update"
## SOTA credentials requires java from the host
HOSTTOOLS += "${@'java' if d.getVar('SOTA_PACKED_CREDENTIALS') else ''}"

# Prelinking increases the size of downloads and causes build errors
USER_CLASSES:remove = "image-prelink"

# For live/installer images
INITRD_IMAGE_LIVE ?= "core-image-minimal-initramfs"
LIVE_ROOTFS_TYPE = "ota-ext4"
LABELS_LIVE = "install"

# General
WKS_FILE_DEPENDS_BOOTLOADERS:remove = "syslinux"

# WKS partition default configuration
OSTREE_WKS_EFI_SIZE ?= "--size 512M"
OSTREE_WKS_BOOT_SIZE ?= "--size 200M --overhead-factor 1"
```

## meta-lmp-base/conf/layer.conf
```bitbake
# We might have a conf and classes directory, append to BBPATH
BBPATH .= ":${LAYERDIR}"

# We have a recipes directory, add to BBFILES
BBFILES += "${LAYERDIR}/recipes*/*/*.bb ${LAYERDIR}/recipes*/*/*.bbappend"

BBFILE_COLLECTIONS += "meta-lmp-base"
BBFILE_PATTERN_meta-lmp-base := "^${LAYERDIR}/"
BBFILE_PRIORITY_meta-lmp-base = "9"

LAYERDEPENDS_meta-lmp-base = " \
    core \
    openembedded-layer \
    filesystems-layer \
    networking-layer \
    perl-layer \
    meta-python \
    virtualization-layer \
    sota \
    security \
"
LAYERSERIES_COMPAT_meta-lmp-base = "nanbield"

BBFILES_DYNAMIC += " \
    integrity:${LAYERDIR}/dynamic-layers/integrity/*/*/*.bb \
    integrity:${LAYERDIR}/dynamic-layers/integrity/*/*/*.bbappend \
    meta-arm:${LAYERDIR}/dynamic-layers/meta-arm/*/*/*.bb \
    meta-arm:${LAYERDIR}/dynamic-layers/meta-arm/*/*/*.bbappend \
    parsec-layer:${LAYERDIR}/dynamic-layers/parsec-layer/*/*/*.bb \
    parsec-layer:${LAYERDIR}/dynamic-layers/parsec-layer/*/*/*.bbappend \
    tpm-layer:${LAYERDIR}/dynamic-layers/tpm-layer/*/*/*.bb \
    tpm-layer:${LAYERDIR}/dynamic-layers/tpm-layer/*/*/*.bbappend \
"

# A list of recipes that are completely stable and will never change.
SIGGEN_EXCLUDERECIPES_ABISAFE += " \
    os-release \
    base-files-issue \
"

# A list of recipe dependencies that should not be used to determine signatures
# of tasks from one recipe when they depend on tasks from another recipe.
SIGGEN_EXCLUDE_SAFE_RECIPE_DEPS += " \
    initramfs-ostree-lmp-image->os-release \
    initramfs-ostree-lmp-recovery->os-release \
    core-image-minimal-initramfs->os-release \
    fsl-image-mfgtool-initramfs->os-release \
"
```

## meta-lmp-base/wic/efidisk-sota.wks
```
# short-description: Create an OTA-enabled EFI disk image
# long-description: Creates an OTA-enabled EFI disk image that the user
# can directly dd to boot media.

part /boot/efi --source bootimg-sota-efi --sourceparams="loader=grub-efi" --ondisk sda --active --align 1024 --use-uuid --size 100
part / --source otaimage --ondisk sda --fstype=ext4 --align 1024 --use-uuid

bootloader --source bootimg-sota-efi --ptable gpt --configfile="grub-ota.cfg"
```

## meta-lmp-base/wic/sdimage-mbr-efi-sota.wks
```
# short-description: Create OTA-enabled MBR SD card image compatible with UEFI
# long-description: Creates a partitioned MBR SD card image compatible with UEFI,
# using OSTree physical sysroot as a payload. Firmware related boot files located
# in the first vfat partition (firmware) and UEFI related files and setup available
# at the second vfat partition (id 0xef)

part firmware --source bootimg-partition --fstype=vfat --system-id 0xf8 --label boot --active --align 4096 --size 32
part /boot/efi --source bootimg-sota-efi --sourceparams="loader=grub-efi" --fstype=vfat --system-id 0xef --label efi --align 4096 --use-uuid --fixed-size 128M
part / --source otaimage --fstype=ext4 --align 4096 --use-uuid
bootloader --configfile="grub-ota.cfg"
```

## meta-lmp-bsp/conf/layer.conf
```bitbake
# We might have a conf and classes directory, append to BBPATH
BBPATH .= ":${LAYERDIR}"

# We have a recipes directory, add to BBFILES
BBFILES += "${LAYERDIR}/recipes*/*/*.bb ${LAYERDIR}/recipes*/*/*.bbappend"

BBFILE_COLLECTIONS += "meta-lmp-bsp"
BBFILE_PATTERN_meta-lmp-bsp := "^${LAYERDIR}/"
BBFILE_PRIORITY_meta-lmp-bsp = "9"

LAYERDEPENDS_meta-lmp-bsp = "core meta-lmp-base"
LAYERSERIES_COMPAT_meta-lmp-bsp = "hardknott"

BBFILES_DYNAMIC += " \
    meta-arm:${LAYERDIR}/dynamic-layers/meta-arm/*/*/*.bb \
    meta-arm:${LAYERDIR}/dynamic-layers/meta-arm/*/*/*.bbappend \
    freescale-layer:${LAYERDIR}/dynamic-layers/freescale-layer/*/*/*.bb \
    freescale-layer:${LAYERDIR}/dynamic-layers/freescale-layer/*/*/*.bbappend \
    stm-st-stm32mp:${LAYERDIR}/dynamic-layers/stm-st-stm32mp/*/*/*.bb \
    stm-st-stm32mp:${LAYERDIR}/dynamic-layers/stm-st-stm32mp/*/*/*.bbappend \
    xilinx:${LAYERDIR}/dynamic-layers/xilinx/*/*/*.bb \
    xilinx:${LAYERDIR}/dynamic-layers/xilinx/*/*/*.bbappend \
    xilinx-tools:${LAYERDIR}/dynamic-layers/xilinx-tools/*/*/*.bb \
    xilinx-tools:${LAYERDIR}/dynamic-layers/xilinx-tools/*/*/*.bbappend \
"
```

## meta-lmp-bsp/conf/machine/apalis-imx6-sec.conf
```bitbake
#@TYPE: Machine
#@NAME: Toradex Apalis iMX6Q/D Secure
#@SOC: i.MX6Q
#@DESCRIPTION: Machine configuration for Toradex Apalis iMX6 SOM with secure
#              boot enabled by default
#@MAINTAINER: Vanessa Maegima <vanessa.maegima@foundries.io>

MACHINEOVERRIDES =. "apalis-imx6:"

require conf/machine/apalis-imx6.conf

KMACHINE = "apalis-imx6"

MACHINE_FEATURES += "fiovb"
```

## meta-lmp-bsp/conf/machine/apalis-imx8-sec.conf
```bitbake
#@TYPE: Machine
#@NAME: Toradex Apalis iMX8 Secure
#@SOC: i.MX8QM
#@DESCRIPTION: Machine configuration for Toradex Apalis iMX8 SOM with secure
#              boot enabled by default
#@MAINTAINER: Igor Opaniuk <igor.opaniuk@foundries.io>

MACHINEOVERRIDES =. "apalis-imx8:"

require conf/machine/apalis-imx8.conf

KMACHINE = "apalis-imx8"

MACHINE_FEATURES += "fiovb"
```

## meta-lmp-bsp/conf/machine/apalis-imx8.conf
```bitbake
#@TYPE: Machine
#@NAME: Toradex Apalis iMX8
#@DESCRIPTION: Toradex Apalis iMX8 powered by a i.MX 8QuadMax SoC
#@MAINTAINER: Stefan Agner <stefan.agner@toradex.com>

MACHINE_NAME = "Apalis-iMX8"
SPL_BINARY = "spl/u-boot-spl.bin"

SOC_SILICON_REV ?= ""

MACHINEOVERRIDES =. "mx8:mx8qm:toradex:"

IMX_DEFAULT_BSP = "nxp"

require conf/machine/include/imx-base.inc
# override imx-base.inc which sets this to cortexa72-cortexa53-crypto
DEFAULTTUNE_mx8qm = "aarch64"
require conf/machine/include/tune-cortexa72-cortexa53.inc

# Don't include kernels in standard images
RDEPENDS_${KERNEL_PACKAGE_NAME}-base = ""

LOADADDR = ""

# we do not want to have getty running on tty1 as we run
# auto-serial-console there
USE_VT = "0"

KERNEL_DEVICETREE = " \
    freescale/imx8qm-apalis-eval.dtb \
    freescale/imx8qm-apalis-ixora-v1.1.dtb \
    freescale/imx8qm-apalis-v1.1-eval.dtb \
"

UBOOT_SUFFIX = "bin"
UBOOT_CONFIG ??= "sd"
UBOOT_CONFIG[sd] = "apalis-imx8_defconfig,sdcard"

UBOOT_ENTRYPOINT = "0x80280000"
UBOOT_DTB_LOADADDRESS = "0x83000000"

IMX_BOOT_SEEK = "32"

IMAGE_BOOT_FILES += "hdmitxfw.bin dpfw.bin"
WKS_FILE_DEPENDS_append = " u-boot-default-script"
PREFERRED_PROVIDER_u-boot-default-script ?= "u-boot-base-scr"

PREFERRED_PROVIDER_virtual/kernel = "linux-lmp-toradex-imx"
PREFERRED_PROVIDER_virtual/bootloader = "u-boot-fio"
PREFERRED_VERSION_u-boot-fio ?= "2020.04"

MACHINE_FIRMWARE_append = " linux-firmware-pcie8997"
MACHINE_FIRMWARE_append = " firmware-imx-vpu-imx8"
MACHINE_FIRMWARE_append = " firmware-imx-8"

IMXBOOT_TARGETS = "flash_b0"

PREFERRED_PROVIDER_imx-sc-firmware = "imx-sc-firmware-toradex"
BOARD_TYPE = "apalis"
```

## meta-lmp-bsp/conf/machine/imx6ullevk-sec.conf
```bitbake
#@TYPE: Machine
#@NAME: NXP i.MX6ULL Evaluation Kit
#@SOC: i.MX6ULL
#@DESCRIPTION: Machine configuration for NXP i.MX6ULL EVK with secure boot
#              enabled by default
#@MAINTAINER: Daiane Angolini <daiane.angolini@foundries.io>

MACHINEOVERRIDES =. "imx6ullevk:"

require conf/machine/imx6ullevk.conf

KMACHINE = "imx6ullevk"
```

## meta-lmp-bsp/conf/machine/imx7ulpea-ucom.conf
```bitbake
#@TYPE: Machine
#@NAME: Embedded Artists i.MX7 ULP uCOM Board
#@SOC: i.MX7D
#@DESCRIPTION: Machine configuration for Embedded Artists i.MX7 ULP uCOM Board
#@MAINTAINER: Ricardo Salveti <ricardo@foundries.io>

MACHINEOVERRIDES =. "mx7:mx7ulp:"

require conf/machine/include/imx-base.inc
require conf/machine/include/tune-cortexa7.inc

SERIAL_CONSOLES = "115200;ttyLP0"

MACHINE_FEATURES += " pci bluetooth optee"

PREFERRED_PROVIDER_virtual/kernel = "linux-lmp-ea-imx"

KERNEL_DEVICETREE = "imx7ulpea-ucom-kit_v2.dtb"

IMX_DEFAULT_BOOTLOADER = "u-boot-fio"
PREFERRED_VERSION_u-boot-fio ?= "2020.04"
PREFERRED_PROVIDER_u-boot-default-script ?= "u-boot-base-scr"

SPL_BINARY = "SPL"
UBOOT_CONFIG ??= "sd"
UBOOT_CONFIG[sd] = "mx7ulp_com_defconfig"

UBOOT_SUFFIX = "bin"
UBOOT_MAKE_TARGET = ""

WKS_FILE_DEPENDS_append = " u-boot-default-script"
```

## meta-lmp-bsp/conf/machine/imx8mm-lpddr4-evk-ebbr.conf
```bitbake
#@TYPE: Machine
#@NAME: NXP i.MX 8M Mini EVK with LPDDR4 and EBBR
#@SOC: i.MX8MM
#@DESCRIPTION: Machine configuration for NXP i.MX 8M Mini Evaluation Kit with LPDDR4
#              following the EBBR requirements (UEFI)

require conf/machine/imx8mm-lpddr4-evk.conf

KMACHINE = "imx8mmevk"
MACHINE_FEATURES += "efi ebbr"
MACHINEOVERRIDES .= ":imx8mm-lpddr4-evk:imx8mm-lpddr4-evk-ebbr"
```
