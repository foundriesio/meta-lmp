/* Device Tree overlay required to flip RaspberryPi 7" Touchscreen panel */
/dts-v1/;
/plugin/;

/ {
	compatible = "brcm,bcm2835", "brcm,bcm2708", "brcm,bcm2709";

	fragment@0 {
		target = <&lcdpi>;
		__overlay__ {
			compatible = "raspberrypi,7inch-touchscreen-panel";
			lcd-rotate = <2>;
		};
	};
};
