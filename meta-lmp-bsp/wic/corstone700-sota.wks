## meta-lmp-bsp/wic/corstone700-sota.wks
```
# WIC partitioning for corstone700
# Layout and maximum sizes:
#
# SPITOC: 1 KB
# SE Ram FW: 32 KB
# FIP image: 991 KB (composed of FIPTOC, BL32 and DTB)
# XIP Cramfs rootfs: 2 MB
# XIP Linux kernel: 5 MB

part --source rawcopy --sourceparams="file=spitoc.bin" --no-table --align 1 --fixed-size 1k
part --source rawcopy --sourceparams="file=se_ramfw.bin" --no-table --align 1 --fixed-size 32k
part --source rawcopy --sourceparams="file=fip.bin" --no-table --align 1 --fixed-size 991k
part --source rawcopy --sourceparams="file=initramfs-ostree-lmp-image-${MACHINE}.cpio.gz" --no-table --fixed-size 2
part --source rawcopy --sourceparams="file=xipImage" --no-table --fixed-size 5
```

## meta-lmp-bsp/wic/emmc-imx-gpt-sota.wks
```
# short-description: Create an OTA-enabled iMX GPT disk image
# long-description: Creates an OTA-enabled iMX GPT compatible disk image to
# be flashed in eMMC (for devices booting from boot0/boot1).

part /boot --source bootimg-partition --ondisk mmcblk --fstype=vfat --label boot --active --align 1024 --use-uuid --size 128M
part / --source otaimage --ondisk mmcblk --part-name=otaroot --fstype=ext4 --align 1024 --use-uuid

bootloader --ptable gpt
```

## meta-lmp-bsp/wic/sdimage-freedom-u540-spl-sota.wks
```
# short-description: Create SD card image for HiFive Unleashed development
#   board with U-Boot SPL and OpenSBI (FW_DYNAMIC)
# long-description: Creates a partitioned SD card image with OSTree
#   physical sysroot as a payload. Boot files are located in the
#   first vfat partition.
#
# orignal-source: https://github.com/sifive/meta-sifive/blob/2021.03/scripts/lib/wic/canned-wks/freedom-u540-spl-opensbi.wks
#
# The disk layout used is:
#  - ------ ------------- -------------- -------------
# | | FSBL | u-boot.itb  |     boot     |    rootfs   |
#  - ------ ------------- -------------- -------------
# ^ ^ 1MiB ^ 4MiB        ^ 83MiB        ^
# | |      |             |              |
# 0 17kiB  ~1MiB         8MiB           92MiB + rootfs + IMAGE_EXTRA_SPACE (default 10MiB)

part --source rawcopy --sourceparams="file=u-boot-spl.bin" --ondisk mmcblk0 --fixed-size 1M --align 17 --part-type 5b193300-fc78-40cd-8002-e86c45580b47
part --source rawcopy --sourceparams="file=u-boot.itb" --ondisk mmcblk0 --fixed-size 4M --align 1 --part-type 2e54b353-1271-4842-806f-e436d6af6985
part /boot --source bootimg-partition --ondisk mmcblk --fstype=vfat --label boot --active --align 4096 --size 64
part / --source otaimage --ondisk mmcblk --fstype=ext4 --align 4096

bootloader --ptable gpt
```

## meta-lmp-bsp/wic/sdimage-imx-sota.wks
```
# short-description: Create OTA-enabled SD card image with a boot partition
# long-description: Creates a partitioned SD card image with OSTree
# physical sysroot as a payload. Boot files are located in the
# first vfat partition.
#
# The disk layout used is:
#  - --------- -------------- --------------
# | | u-boot  |     boot     |    rootfs   |
#  - --------- -------------- --------------
# ^ ^         ^              ^
# | |         |              |
# 0 1kiB    4MiB          16MiB + rootfs + IMAGE_EXTRA_SPACE (default 10MiB)
#
part u-boot --source rawcopy --sourceparams="file=u-boot.imx" --ondisk mmcblk --no-table --align 1
part /boot --source bootimg-partition --ondisk mmcblk --fstype=vfat --label boot --active --align 4096 --size 16
part / --source otaimage --ondisk mmcblk --fstype=ext4 --align 4096

bootloader --ptable msdos
```

## meta-lmp-bsp/wic/sdimage-imx6dq-spl-fit.wks
```
# short-description: Create SD card image with a boot partition
# long-description: Creates a partitioned SD card image. Boot files
# are located in the first vfat partition (using SPL -> u-boot fit for
# boot flow).
#
# The disk layout used is:
#  - ----- --------- -------------- --------------
# | | SPL | u-boot  |     boot     |    rootfs   |
#  - ----- --------- -------------- --------------
# ^ ^     ^         ^              ^
# | |     |         |              |
# 0 1kiB  197kiB  4MiB          16MiB + rootfs + IMAGE_EXTRA_SPACE (default 10MiB)
#
part SPL --source rawcopy --sourceparams="file=SPL" --ondisk mmcblk --no-table --align 1
part u-boot --source rawcopy --sourceparams="file=u-boot.itb" --ondisk mmcblk --no-table --align 197
part /boot --source bootimg-partition --ondisk mmcblk --fstype=vfat --label boot --active --align 4096 --size 16
part / --source rootfs --ondisk mmcblk0 --fstype=ext4 --label root --align 4

bootloader --ptable msdos
```

## meta-lmp-bsp/wic/sdimage-imx7-spl-sota.wks
```
# short-description: Create OTA-enabled SD card image with a boot partition
# long-description: Creates a partitioned SD card image with OSTree
# physical sysroot as a payload. Boot files are located in the
# first vfat partition.
#
# The disk layout used is:
#  - ----- --------- -------------- --------------
# | | SPL | u-boot  |     boot     |    rootfs   |
#  - ----- --------- -------------- --------------
# ^ ^     ^         ^              ^
# | |     |         |              |
# 0 1kiB  64kiB   4MiB          16MiB + rootfs + IMAGE_EXTRA_SPACE (default 10MiB)
#
part SPL --source rawcopy --sourceparams="file=SPL" --ondisk mmcblk --no-table --align 1
part u-boot --source rawcopy --sourceparams="file=u-boot.img" --ondisk mmcblk --no-table --align 64
part /boot --source bootimg-partition --ondisk mmcblk --fstype=vfat --label boot --active --align 4096 --size 16
part / --source otaimage --ondisk mmcblk --fstype=ext4 --align 4096

bootloader --ptable msdos
```

## recipes-bsp/u-boot/u-boot-compulab-2016.09/cl_som_imx7_defconfig
```kconfig
CONFIG_ARM=y
CONFIG_ARCH_MX7=y
CONFIG_TARGET_CL_SOM_IMX7=y
CONFIG_ARMV7_BOOT_SEC_DEFAULT=y
CONFIG_IMX_RDC=y
CONFIG_IMX_BOOTAUX=y
CONFIG_OF_BOARD_SETUP=y
CONFIG_SYS_EXTRA_OPTIONS="IMX_CONFIG=board/compulab/cl_som_imx7/imximage.cfg"
CONFIG_SPI_BOOT=y
CONFIG_BOOTDELAY=3
CONFIG_HUSH_PARSER=y
CONFIG_SYS_PROMPT="CL-SOM-iMX7 # "
CONFIG_CMD_BOOTZ=y
# CONFIG_CMD_IMI is not set
# CONFIG_CMD_IMLS is not set
# CONFIG_CMD_XIMG is not set
# CONFIG_CMD_EXPORTENV is not set
# CONFIG_CMD_IMPORTENV is not set
CONFIG_CMD_GREPENV=y
CONFIG_CMD_MMC=y
CONFIG_CMD_SF=y
CONFIG_CMD_I2C=y
CONFIG_CMD_USB=y
CONFIG_CMD_GPIO=y
CONFIG_CMD_DHCP=y
CONFIG_CMD_MII=y
CONFIG_CMD_PING=y
CONFIG_CMD_CACHE=y
CONFIG_CMD_EXT2=y
CONFIG_CMD_EXT4=y
CONFIG_CMD_EXT4_WRITE=y
CONFIG_CMD_FAT=y
CONFIG_CMD_FS_GENERIC=y
CONFIG_SPI_FLASH=y
CONFIG_SPI_FLASH_STMICRO=y
CONFIG_USB=y
CONFIG_USB_EHCI_HCD=y
CONFIG_MXC_USB_OTG_HACTIVE=y
CONFIG_USB_STORAGE=y
CONFIG_USB_GADGET=y
CONFIG_CI_UDC=y
CONFIG_OF_LIBFDT=y
```

## wic/beaglebone.wks
```
# short-description: Create SD card image for Beaglebone
# long-description: Creates a partitioned SD card image for Beaglebone.
# Boot files are located in the first vfat partition.

part /boot/u-boot --source bootimg-partition --ondisk mmcblk0 --fstype=vfat --label boot --active --align 4 --size 16 --fsoptions "defaults,noauto"
part / --source rootfs --ondisk mmcblk0 --fstype=ext4 --label root --align 4
```

## wic/cl-som-imx7.wks
```
# short-description: Create SD card image with a boot partition
# long-description:
# Create an image that can be written onto a SD card using dd for use
# with i.MX SoC family
# It uses u-boot
#
# The disk layout used is:
#  - ----- --------- -------------- --------------
# | | SPL | u-boot  |     boot     |    rootfs   |
#  - ----- --------- -------------- --------------
# ^ ^     ^         ^              ^
# | |     |         |              |
# 0 1kiB  64kiB   4MiB          16MiB + rootfs + IMAGE_EXTRA_SPACE (default 10MiB)
#
part SPL --source rawcopy --sourceparams="file=SPL" --ondisk mmcblk0 --no-table --align 1
part u-boot --source rawcopy --sourceparams="file=u-boot.img" --ondisk mmcblk0 --no-table --align 64
part /boot --source bootimg-partition --ondisk mmcblk0 --fstype=vfat --label boot --active --align 4096 --size 16
part / --source rootfs --ondisk mmcblk0 --fstype=ext4 --label root --align 4096

bootloader --ptable msdos
```

## wic/efidisk-sota.wks
```
# short-description: Create an OTA-enabled EFI disk image
# long-description: Creates an OTA-enabled EFI disk image that the user
# can directly dd to boot media.

part /boot/efi --source bootimg-sota-efi --sourceparams="loader=grub-efi" --ondisk sda --active --align 1024 --use-uuid
part / --source otaimage --ondisk sda --fstype=ext4 --align 1024 --use-uuid

bootloader --ptable gpt --configfile="grub-ota.cfg"
```

## wic/efidisk.wks
```
# short-description: Create an EFI disk image
# long-description: Creates a partitioned EFI disk image that the user
# can directly dd to boot media. The selected bootloader is grub-efi.

part /boot/efi --source bootimg-efi --sourceparams="loader=grub-efi" --ondisk sda --label efi --active --align 1024 --use-uuid
part / --source rootfs --ondisk sda --fstype=ext4 --label rootfs --align 1024 --use-uuid
bootloader --ptable gpt --timeout=3 --append="rootfstype=ext4 console=ttyS0,115200 console=tty0"
```

## wic/freedom-u540-bbl-sota.wks
```
# short-description: Create OTA-enabled SD card image for RISC-V boards that depends on BBL

part bbl --source rawcopy --sourceparams="file=bbl.bin" --ondisk mmcblk --align 1 --part-type 2e54b353-1271-4842-806f-e436d6af6985
part / --source otaimage --ondisk mmcblk --fstype=ext4 --align 4096

bootloader --ptable gpt
```

## wic/raspberrypi.wks
```
# short-description: Create SD card image for Raspberry Pi
# long-description: Creates a partitioned SD card image for Raspberry Pi.
# Boot files are located in the first vfat partition.

part --source bootimg-partition --ondisk mmcblk0 --fstype=vfat --label boot --active --align 4096 --size 40 --use-uuid
part / --source rootfs --ondisk mmcblk0 --fstype=ext4 --label root --align 4096 --use-uuid
```
