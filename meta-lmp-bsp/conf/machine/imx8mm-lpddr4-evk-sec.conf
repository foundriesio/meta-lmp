## meta-lmp-bsp/conf/machine/include/lmp-mfgtool-machine-custom.inc
```bitbake
# iMX6UL
UBOOT_SIGN_ENABLE:mx6ul-generic-bsp = "1"
PREFERRED_PROVIDER_virtual/kernel:mx6ul-nxp-bsp = "linux-lmp-dev-mfgtool"
IMX_DEFAULT_BOOTLOADER:mx6ul-generic-bsp ?= "u-boot-fio-mfgtool"
PREFERRED_PROVIDER_u-boot-default-script:mx6ul-generic-bsp = "u-boot-ostree-scr-fit"
UBOOT_CLASSES:mx6ul-generic-bsp = "uboot-fitimage"
IMAGE_BOOT_FILES:remove:mx6ul-generic-bsp = "boot.scr uEnv.txt zImage"
IMAGE_BOOT_FILES:append:mx6ul-generic-bsp = " boot.itb SPL u-boot.itb"
KERNEL_IMAGETYPE:mx6ul-generic-bsp = "fitImage"
KERNEL_CLASSES:mx6ul-generic-bsp = " kernel-lmp-fitimage "
PREFERRED_VERSION_u-boot-fio-mfgtool:mx6ul-nxp-bsp ?= "imx-2023.04"

# iMX6ULL
UBOOT_SIGN_ENABLE:mx6ull-generic-bsp = "1"
PREFERRED_PROVIDER_virtual/kernel:mx6ull-nxp-bsp = "linux-lmp-dev-mfgtool"
IMX_DEFAULT_BOOTLOADER:mx6ull-generic-bsp ?= "u-boot-fio-mfgtool"
PREFERRED_PROVIDER_u-boot-default-script:mx6ull-generic-bsp = "u-boot-ostree-scr-fit"
UBOOT_CLASSES:mx6ull-generic-bsp = "uboot-fitimage"
IMAGE_BOOT_FILES:remove:mx6ull-generic-bsp = "boot.scr uEnv.txt zImage"
IMAGE_BOOT_FILES:append:mx6ull-generic-bsp = " boot.itb SPL u-boot.itb"
KERNEL_IMAGETYPE:mx6ull-generic-bsp = "fitImage"
KERNEL_CLASSES:mx6ull-generic-bsp = " kernel-lmp-fitimage "
PREFERRED_VERSION_u-boot-fio-mfgtool:mx6ull-generic-bsp ?= "imx-2023.04"

# iMX8MQ
UBOOT_SIGN_ENABLE:mx8mq-generic-bsp = "1"
PREFERRED_PROVIDER_virtual/kernel:mx8mq-nxp-bsp = "linux-lmp-dev-mfgtool"
IMX_DEFAULT_BOOTLOADER:mx8mq-generic-bsp ?= "u-boot-fio-mfgtool"
PREFERRED_PROVIDER_u-boot-default-script:mx8mq-generic-bsp = "u-boot-ostree-scr-fit"
IMAGE_BOOT_FILES:mx8mq-nxp-bsp  = "imx-boot u-boot.itb boot.itb"
KERNEL_IMAGETYPE:mx8mq-generic-bsp = "fitImage"
KERNEL_CLASSES:mx8mq-generic-bsp = " kernel-lmp-fitimage "
PREFERRED_VERSION_u-boot-fio-mfgtool:mx8mq-nxp-bsp ?= "imx-2023.04"

# iMX8MPEVK
UBOOT_SIGN_ENABLE:mx8mp-generic-bsp = "1"
IMX_DEFAULT_BOOTLOADER:mx8mp-generic-bsp ?= "u-boot-fio-mfgtool"
PREFERRED_PROVIDER_u-boot-default-script:mx8mp-generic-bsp = "u-boot-ostree-scr"
IMAGE_BOOT_FILES:mx8mp-nxp-bsp  = "imx-boot u-boot.itb boot.itb"
KERNEL_IMAGETYPE:mx8mp-generic-bsp = "fitImage"
KERNEL_CLASSES:mx8mp-generic-bsp = " kernel-lmp-fitimage "
IMXBOOT_TARGETS:imx8mp-lpddr4-evk = "flash_evk"
PREFERRED_VERSION_u-boot-fio-mfgtool:mx8mp-nxp-bsp ?= "imx-2023.04"

# iMX8MM
UBOOT_SIGN_ENABLE:mx8mm-generic-bsp = "1"
IMX_DEFAULT_BOOTLOADER:mx8mm-generic-bsp ?= "u-boot-fio-mfgtool"
PREFERRED_PROVIDER_u-boot-default-script:mx8mm-generic-bsp = "u-boot-ostree-scr"
IMAGE_BOOT_FILES:mx8mm-nxp-bsp  = "imx-boot u-boot.itb boot.itb"
KERNEL_IMAGETYPE:mx8mm-generic-bsp = "fitImage"
KERNEL_CLASSES:mx8mm-generic-bsp = " kernel-lmp-fitimage "
PREFERRED_VERSION_u-boot-fio-mfgtool:mx8mm-nxp-bsp ?= "imx-2023.04"

# iMX8MN
UBOOT_SIGN_ENABLE:mx8mn-generic-bsp = "1"
IMX_DEFAULT_BOOTLOADER:mx8mn-generic-bsp ?= "u-boot-fio-mfgtool"
PREFERRED_PROVIDER_u-boot-default-script:mx8mn-generic-bsp = "u-boot-ostree-scr"
IMAGE_BOOT_FILES:mx8mn-nxp-bsp  = "imx-boot u-boot.itb boot.itb"
KERNEL_IMAGETYPE:mx8mn-generic-bsp = "fitImage"
KERNEL_CLASSES:mx8mn-generic-bsp = " kernel-lmp-fitimage "
IMXBOOT_TARGETS:imx8mn-ddr4-evk = "flash_ddr4_evk"
IMXBOOT_TARGETS:imx8mn-lpddr4-evk = "flash_evk"
PREFERRED_VERSION_u-boot-fio-mfgtool:mx8mn-nxp-bsp ?= "imx-2023.04"

# iMX93
UBOOT_SIGN_ENABLE:mx93-generic-bsp = "1"
IMX_DEFAULT_BOOTLOADER:mx93-generic-bsp ?= "u-boot-fio-mfgtool"
PREFERRED_PROVIDER_u-boot-default-script:mx93-generic-bsp = "u-boot-ostree-scr"
IMAGE_BOOT_FILES:mx93-nxp-bsp  = "imx-boot u-boot.itb boot.itb"
KERNEL_IMAGETYPE:mx93-generic-bsp = "fitImage"
KERNEL_CLASSES:mx93-generic-bsp = " kernel-lmp-fitimage "
IMXBOOT_TARGETS:mx93-nxp-bsp = "flash_singleboot"
PREFERRED_VERSION_u-boot-fio-mfgtool:mx93-generic-bsp ?= "imx-2023.04"

# iMX8QM
IMX_DEFAULT_BOOTLOADER:mx8qm-generic-bsp ?= "u-boot-fio-mfgtool"
PREFERRED_PROVIDER_u-boot-default-script:mx8qm-generic-bsp = "u-boot-ostree-scr-fit"
KERNEL_IMAGETYPE:mx8qm-generic-bsp = "fitImage"
KERNEL_CLASSES:mx8qm-generic-bsp = " kernel-lmp-fitimage "
UBOOT_SIGN_ENABLE:mx8qm-generic-bsp = "1"
UBOOT_CLASSES:mx8qm-generic-bsp = "uboot-fitimage"
IMAGE_BOOT_FILES:mx8qm-nxp-bsp  = "imx-boot u-boot.itb boot.itb"
PREFERRED_VERSION_u-boot-fio-mfgtool:mx8qm-nxp-bsp ?= "imx-2023.04"

# TI Generic (BSP)
INITRAMFS_IMAGE:k3 = "initramfs-ostree-lmp-recovery"
EXTRA_IMAGEDEPENDS:remove:k3 = "u-boot-default-script"
PREFERRED_PROVIDER_virtual/optee-os:k3 = "optee-os-fio-mfgtool"
KERNEL_IMAGETYPE:k3 = "fitImage"
KERNEL_CLASSES:k3 = " kernel-lmp-fitimage "
# TI AM62XX EVM
UBOOT_CONFIG_FRAGMENTS:am62xx-evm-k3r5 = "am62x_r5_usbdfu.config"

# Cross machines / BSPs
PREFERRED_VERSION_u-boot-fio-mfgtool:imx-nxp-bsp ?= "imx-2022.04"
```

## meta-lmp-bsp/conf/machine/include/ultrazed-lmp.inc
```bitbake
# Avnet UltraZed Generic Settings

MACHINEOVERRIDES =. "uz:uz3eg:"

require conf/machine/include/zynqmp-lmp.inc
```

## meta-lmp-bsp/conf/machine/include/zynqmp-lmp.inc
```bitbake
# Based on xilinx-board.inc, but with correct MACHINEOVERRIDES settings
BOARD ??= ""
BOARD_VARIANT ??= ""
BOARD_ARCH ?= "${@['${BOARD}', '${MACHINE_ARCH}'][d.getVar('BOARD')=='']}"
BOARDVARIANT_ARCH ?= "${@['${BOARD}-${BOARD_VARIANT}','${BOARD_ARCH}'][d.getVar('BOARD_VARIANT')=='']}"
MACHINEOVERRIDES =. "${@['', '${BOARD}-${BOARD_VARIANT}:']['${BOARD_VARIANT}' != '']}"
MACHINEOVERRIDES =. "${@['', '${BOARD}:']['${BOARD}' != '']}"
PACKAGE_EXTRA_ARCHS:append = "${@['', ' ${BOARD_ARCH}'][d.getVar('BOARDVARIANT_ARCH') != d.getVar('MACHINE_ARCH')]}"
PACKAGE_EXTRA_ARCHS:append = "${@['', ' ${BOARDVARIANT_ARCH}'][d.getVar('BOARDVARIANT_ARCH') != d.getVar('BOARD_ARCH')]}"

XILINX_VER_MAIN ?= "2021.2"

PREFERRED_PROVIDER_virtual/kernel:zynqmp ?= "linux-lmp-xlnx"

require conf/machine/include/soc-zynqmp.inc
require conf/machine/include/machine-xilinx-default.inc

MACHINE_FEATURES = "rtc ext2 ext3 vfat usbhost usbgadget wifi bluetooth optee"

EXTRA_IMAGEDEPENDS += "libyaml-native python3-cython-native python3-pyyaml-native"

PREFERRED_PROVIDER_virtual/bitstream ?= "bitstream-extraction"

PREFERRED_PROVIDER_u-boot = "u-boot-xlnx"
PREFERRED_PROVIDER_virtual/boot-bin ?= "u-boot-xlnx"
PREFERRED_PROVIDER_u-boot-fw-utils = "libubootenv"
PREFERRED_RPROVIDER_u-boot-fw-utils = "libubootenv"
SOTA_CLIENT_FEATURES:append = " ubootenv"
WKS_FILE_DEPENDS:append = " u-boot-default-script"
PREFERRED_PROVIDER_u-boot-default-script = "u-boot-base-scr"
PREFERRED_PROVIDER_u-boot-default-script:sota ?= "u-boot-ostree-scr-fit"

SPL_BINARY ?= "spl/boot.bin"
UBOOT_MACHINE ?= "xilinx_zynqmp_virt_defconfig"
UBOOT_CLASSES = "uboot-fitimage"
UBOOT_ENTRYPOINT  = "0x18000000"
UBOOT_DTB_LOADADDRESS = "0x40000000"

EFI_PROVIDER ?= "${@bb.utils.contains('MACHINE_FEATURES', 'ebbr', 'grub-efi', '', d)}"

ATF_BINARY = "arm-trusted-firmware.bin"
ATF_MEM_BASE = "0xfffe5000"
ATF_MEM_SIZE = "0x1affe"

SERIAL_CONSOLES ?= "115200;ttyPS0"

OSTREE_BOOTLOADER ?= "${@bb.utils.contains('MACHINE_FEATURES', 'ebbr', 'grub', 'u-boot', d)}"
KERNEL_IMAGETYPE:sota ?= "${@bb.utils.contains('MACHINE_FEATURES', 'ebbr', 'Image', 'fitImage', d)}"
KERNEL_CLASSES:sota ?= "${@bb.utils.contains('MACHINE_FEATURES', 'ebbr', '', ' kernel-lmp-fitimage ', d)}"
OSTREE_KERNEL_ARGS ?= "console=ttyPS0,115200 ${OSTREE_KERNEL_ARGS_COMMON}"
PREFERRED_PROVIDER_virtual/dtb ?= "device-tree"
PREFERRED_PROVIDER_virtual/trusted-firmware-a ?= "arm-trusted-firmware"

EXTRA_IMAGEDEPENDS += " \
    virtual/bitstream \
    virtual/bootloader \
    virtual/pmu-firmware \
    virtual/boot-bin \
    virtual/trusted-firmware-a \
    ${@bb.utils.contains('OSTREE_BOOTLOADER', 'grub', 'grub-efi', '', d)} \
"

# Used to create a wic image to boot from emmc
WKS_FILE = "sdimage-bootpart.wks"
WKS_FILE:sota = "${@bb.utils.contains('MACHINE_FEATURES', 'ebbr', 'sdimage-mbr-efi-sota.wks', 'sdimage-sota.wks', d)}"
WKS_FILE_DEPENDS:append = " virtual/bootloader"
IMAGE_BOOT_FILES = "${@get_default_image_boot_files(d)} boot.bin boot.scr uEnv.txt devicetree/system-top.dtb;system-top.dtb bitstream.bit.bin"
IMAGE_BOOT_FILES:sota = "boot.bin;boot0001.bin u-boot.itb;u-boot0001.itb boot.bin;boot0002.bin u-boot.itb;u-boot0002.itb"
IMAGE_BOOT_FILES:sota:append = " ${@bb.utils.contains('MACHINE_FEATURES', 'ebbr', 'devicetree/system-top.dtb;system-top.dtb', '', d)}"

# Boot firmware updates
LMP_BOOT_FIRMWARE_FILES:sota = "boot.bin u-boot.itb"
BOOTSCR_LOAD_ADDR:sota = "0x21000000"

# Not building for QEMU standard Xinix build
EXTRA_IMAGEDEPENDS:remove = "qemu-devicetrees"
```

## meta-lmp-bsp/conf/machine/kv260-ebbr.conf
```bitbake
#@TYPE: Machine
#@NAME: kv260-ebbr
#@DESCRIPTION: Machine support for Kria KV260 Vision AI Starter Kit customized for LmP
#              and following the EBBR requirements (UEFI)

MACHINEOVERRIDES =. "kv260:"

require kv260.conf

MACHINE_FEATURES += "efi ebbr"

KMACHINE = "kv260"

# Drop boot.scr as it is expected for u-boot to run the efi payload
WKS_FILE_DEPENDS:remove = "u-boot-ostree-scr"
IMAGE_BOOT_FILES:remove = "boot.scr uEnv.txt"
```

## meta-lmp-bsp/conf/machine/kv260.conf
```bitbake
#@TYPE: Machine
#@NAME: kv260
#@DESCRIPTION: Machine support for Kria KV260 Vision AI Starter Kit customized for LmP

DEFAULTTUNE = "cortexa53"
SOC_VARIANT = "ev"

# Set MACHINEOVERRIDES manually instead of using BOARD / BOARD_VARIANT (now deprecated)
MACHINEOVERRIDES =. "k26:k26-kv:"

# Carriers are configured via overlays
UBOOT_DTBO_LOADADDRESS ?= "0x40100000"

# Build boot.scr for compatibility with the stock firmware
WKS_FILE_DEPENDS:append = " u-boot-ostree-scr"
IMAGE_BOOT_FILES:append = " boot.scr uEnv.txt"

require conf/machine/include/zynqmp-lmp.inc

# DSA file taken from xilinx-k26-starterkit-v2021.1-final.bsp
HDF_BASE = "file://"
HDF_PATH = "system.xsa"
HDF_EXT = "xsa"

# pmu-firmware variables (from meta-som/k26-som.conf)
extra_settings:pn-pmu-firmware = ""
YAML_COMPILER_FLAGS:append:pn-pmu-firmware = " ${extra_settings}"
YAML_SERIAL_CONSOLE_STDIN:pn-pmu-firmware = "psu_uart_1"
YAML_SERIAL_CONSOLE_STDOUT:pn-pmu-firmware = "psu_uart_1"

YAML_SERIAL_CONSOLE_BAUDRATE = "115200"

# bitstream support
MACHINE_FIRMWARE:append = " fpga-manager-script"
MACHINE_EXTRA_RRECOMMENDS += "${MACHINE_FIRMWARE}"
SPL_FPGA_BINARY = "bitstream.bit.bin"
SPL_FPGA_LOAD_ADDR = "0x18000000"

# Make image-update essential as it is required for bootfw updates
MACHINE_ESSENTIAL_EXTRA_RDEPENDS += "image-update"
```

## meta-lmp-bsp/conf/machine/qemuarm64-secureboot-ebbr.conf
```bitbake
#@TYPE: Machine
#@NAME: qemuarm64-secureboot-ebbr
#@DESCRIPTION: Machine configuration for running an ARMv8 system on QEMU
#              following the EBBR requirements (UEFI)

MACHINEOVERRIDES =. "qemuarm64-secureboot:"

require conf/machine/qemuarm64-secureboot.conf

MACHINE_FEATURES += "efi ebbr acpi pci usbhost"
```

## meta-lmp-bsp/conf/machine/stm32mp1-disco.conf
```bitbake
#@TYPE: Machine
#@NAME: stm32mp1-disco
#@DESCRIPTION: Machine configuration for STM32MP157C-DK2
#              Done as a transition to the new machine name available in kirkstone.
#@MAINTAINER: Ricardo Salveti <ricardo@foundries.io>

MACHINEOVERRIDES =. "stm32mp15-disco:"

require conf/machine/stm32mp15-disco.conf
```

## meta-lmp-bsp/conf/machine/stm32mp15-disco-sec.conf
```bitbake
#@TYPE: Machine
#@NAME: STM32MP157C-DK2 Discovery board Secure
#@SOC: STM32MP1
#@DESCRIPTION: Machine configuration for STM32MP157C-DK2 with secure boot
#              enabled by default
#@MAINTAINER: Igor Opaniuk <igor.opaniuk@foundries.io>

MACHINEOVERRIDES =. "stm32mp15-disco:"

require conf/machine/stm32mp15-disco.conf

KMACHINE = "stm32mp15-disco"

STM32_BOOTIMAGE_SUFFIX = "${@bb.utils.contains('STM32_ROT_SIGN_ENABLE', '1', '_Signed', '', d)}"
```

## meta-lmp-bsp/conf/machine/stm32mp15-eval-sec.conf
```bitbake
#@TYPE: Machine
#@NAME: STM32MP157C-EV1 Evaluation board Secure
#@SOC: STM32MP1
#@DESCRIPTION: Machine configuration for STM32MP157C-EV1 with secure boot
#              enabled by default
#@MAINTAINER: Igor Opaniuk <igor.opaniuk@foundries.io>

MACHINEOVERRIDES =. "stm32mp15-eval:"

require conf/machine/stm32mp15-eval.conf

KMACHINE = "stm32mp15-eval"

MACHINE_FEATURES += "fiovb"
```

## meta-lmp-bsp/conf/machine/uz3eg-iocc-ebbr-sec.conf
```bitbake
#@TYPE: Machine
#@NAME: uz3eg-iocc-ebbr-sec
#@DESCRIPTION: Machine support for UltraZed-EG with IOCC customized for LmP
#              with secure boot enabled by default and following EBBR (UEFI)

MACHINEOVERRIDES =. "uz3eg-iocc-sec:"

require uz3eg-iocc-sec.conf

MACHINE_FEATURES += "efi ebbr"
```

## meta-lmp-bsp/conf/machine/uz3eg-iocc-ebbr.conf
```bitbake
#@TYPE: Machine
#@NAME: uz3eg-iocc-ebbr
#@DESCRIPTION: Machine support for UltraZed-EG with IOCC customized for LmP
#              and following the EBBR requirements (UEFI)

MACHINEOVERRIDES =. "uz3eg-iocc:"

require uz3eg-iocc.conf

MACHINE_FEATURES += "efi ebbr"

KMACHINE = "uz3eg-iocc"
```

## meta-lmp-bsp/conf/machine/uz3eg-iocc-sec.conf
```bitbake
#@TYPE: Machine
#@NAME: uz3eg-iocc-sec
#@DESCRIPTION: Machine support for UltraZed-EG with IOCC customized for LmP
#              with secure boot enabled by default

# Signed FPGA bitstream is needed on secure/closed targets
PREFERRED_PROVIDER_virtual/bitstream = "bitstream-signed"

require uz3eg-iocc.conf

SPL_BINARY = "spl/u-boot-spl.bin"
SPL_FPGA_BINARY = "bitstream-signed.bit.bin"
SPL_FPGA_COMPATIBLE = "u-boot,zynqmp-fpga-ddrauth"

PREFERRED_PROVIDER_virtual/boot-bin = "lmp-boot-firmware"
IMAGE_BOOT_FILES_sota = "lmp-boot-firmware/boot.bin;boot0001.bin u-boot.itb;u-boot0001.itb"

KMACHINE = "uz3eg-iocc"
MACHINEOVERRIDES .= ":uz3eg-iocc:uz3eg-iocc-sec"
```

## meta-lmp-bsp/conf/machine/uz3eg-iocc.conf
```bitbake
#@TYPE: Machine
#@NAME: uz3eg-iocc
#@DESCRIPTION: Machine support for UltraZed-EG with IOCC customized for LmP

DEFAULTTUNE = "cortexa53"

require conf/machine/include/ultrazed-lmp.inc

# DSA file taken from UZ3EG_IOCC_2019p1_PetaLinux_SDSoC_Platform.zip ->
#   UZ3EG_IOCC_2019p1_PetaLinux_SDSoC_Platform.tar.gz ->
#     UZ3EG_IOCC/hw/UZ3EG_IOCC.dsa
# https://www.element14.com/community/docs/DOC-93843/l/sdsocplatformv20191pdf?ICID=ultrazedEG-datasheet-widget
HDF_MACHINE ?= "zcu102-zynqmp"
HDF_BASE = "file://"
HDF_PATH = "system.xsa"
HDF_EXT = "xsa"

# bitstream support
MACHINE_FIRMWARE_append = " fpga-manager-script"
MACHINE_EXTRA_RRECOMMENDS += "${MACHINE_FIRMWARE}"
SPL_FPGA_BINARY = "bitstream.bit.bin"
SPL_FPGA_LOAD_ADDR = "0x18000000"
```
