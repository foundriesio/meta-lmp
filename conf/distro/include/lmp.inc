## conf/distro/include/lmp.inc
```bitbake
DISTRO_VERSION = "2.7"

# These default to 'oecore' and 'nodistro'
SDK_NAME_PREFIX = "${DISTRO}"
SDK_VERSION = "${DISTRO_VERSION}"

MAINTAINER = "LMP Support <support@foundries.io>"

TARGET_VENDOR = "-lmp"

TCLIBCAPPEND = ""

require conf/distro/include/arm-defaults.inc
require conf/distro/include/security_flags.inc

PREFERRED_PROVIDER_virtual/kernel ?= "linux-lmp"
PREFERRED_PROVIDER_iasl-native = "acpica-native"
PREFERRED_PROVIDER_zlib ?= "zlib"
PREFERRED_PROVIDER_zlib-native ?= "zlib-native"
PREFERRED_PROVIDER_nativesdk-zlib ?= "nativesdk-zlib"
PREFERRED_RPROVIDER_virtual/network-configuration ?= "networkmanager"

# No need for x11 even for native
DISTRO_FEATURES_NATIVE_remove = "x11"
DISTRO_FEATURES_NATIVESDK_remove = "x11"

# TODO: review default distro features
DISTRO_FEATURES_append = " pam systemd usrmerge virtualization"
DISTRO_FEATURES_remove = "3g alsa irda pcmcia nfc pulseaudio sysvinit"
VIRTUAL-RUNTIME_init_manager = "systemd"
PACKAGECONFIG_append_pn-systemd = " journal-upload resolved networkd"
PACKAGECONFIG_append_pn-qemu-native = " libusb"
PACKAGECONFIG_remove_pn-networkmanager = "dnsmasq"

# Default image formats
IMAGE_FSTYPES = "tar.xz ext4.gz wic wic.gz wic.bmap"
IMAGE_FSTYPES_remove = "tar.gz tar.bz2"

# LMP default classes and overwrites
INHERIT += "lmp"

INHERIT += "buildhistory"
INHERIT += "image-buildinfo"
BUILDHISTORY_COMMIT = "1"

PREMIRRORS ??= "\
     git://.*/.* https://storage.googleapis.com/lmp-cache/downloads/ \n \
     ftp://.*/.* https://storage.googleapis.com/lmp-cache/downloads/ \n \
     http://.*/.* https://storage.googleapis.com/lmp-cache/downloads/ \n \
     https://.*/.* https://storage.googleapis.com/lmp-cache/downloads/ \n \
"

MIRRORS =+ "\
     ftp://.*/.* https://storage.googleapis.com/lmp-cache/downloads/ \n \
     http://.*/.* https://storage.googleapis.com/lmp-cache/downloads/ \n \
     https://.*/.* https://storage.googleapis.com/lmp-cache/downloads/ \n \
"

# QA check settings - follow poky, which is stricter than the OE-Core defaults
WARN_TO_ERROR_QA = "already-stripped compile-host-path install-host-path \
                    installed-vs-shipped ldflags pn-overrides rpaths staticdev \
                    unknown-configure-option useless-rpaths"
WARN_QA_remove = "${WARN_TO_ERROR_QA}"
ERROR_QA_append = " ${WARN_TO_ERROR_QA}"

LMP_USER ?= "osf"
LMP_PASSWORD ?= "osf"
```

## conf/distro/lmp.conf
```bitbake
require conf/distro/include/lmp.inc
require conf/distro/sota.conf.inc

DISTRO = "lmp"
DISTRO_NAME = "Linux-microPlatform"

IMAGE_LINGUAS ?= "en-us"

# SOTA
OSTREE_OSNAME = "lmp"
INITRAMFS_IMAGE = "initramfs-ostree-lmp-image"
INITRAMFS_FSTYPES = "cpio.gz"
OSTREE_KERNEL_ARGS = "root=LABEL=otaroot rootfstype=ext4"
## No need to install the kernel image into the boot partition
IMAGE_BOOT_FILES_remove_sota = " ${KERNEL_IMAGETYPE}"
## Disable default prov by default to allow runtime configuration
SOTA_CLIENT_PROV ?= ""
## Also produce OTA rootfs tarball for additional image support
BUILD_OTA_TARBALL = "1"
## Support Aktualizr with HSM by default for secure SOTA
SOTA_CLIENT_FEATURES_append = " hsm"

# No graphical feature as part of the base platform
DISTRO_FEATURES_remove = "wayland x11"

# General
WKS_FILE_DEPENDS_BOOTLOADERS_remove = "syslinux systemd-boot"
## We don't use the default efi sota wks file
WKS_FILE_sota_remove = "efiimage-sota.wks"
```

## conf/layer.conf
```bitbake
# We might have a conf and classes directory, append to BBPATH
BBPATH .= ":${LAYERDIR}"

# We have a recipes directory, add to BBFILES
BBFILES += "${LAYERDIR}/recipes*/*/*.bb ${LAYERDIR}/recipes*/*/*.bbappend"

BBFILE_COLLECTIONS += "meta-lmp"
BBFILE_PATTERN_meta-lmp := "^${LAYERDIR}/"
BBFILE_PRIORITY_meta-lmp = "9"

LAYERDEPENDS_meta-lmp = "core networking-layer sota virtualization-layer"
LAYERSERIES_COMPAT_meta-lmp = "thud warrior zeus"
```

## conf/machine/cl-som-imx7.conf
```bitbake
#@TYPE: Machine
#@NAME: CompuLab CL-SOM-iMX7
#@SOC: i.MX7D
#@DESCRIPTION: Machine configuration for CompuLab CL-SOM-iMX7 machines
#@MAINTAINER: Ricardo Salveti <ricardo@opensourcefoundries.com>

MACHINEOVERRIDES =. "mx7:mx7d:"

include conf/machine/include/imx-base.inc
include conf/machine/include/tune-cortexa7.inc

PREFERRED_PROVIDER_u_boot = "u-boot-compulab"
PREFERRED_PROVIDER_virtual/bootloader = "u-boot-compulab"
PREFERRED_PROVIDER_virtual/kernel ?= "linux-osf"

UBOOT_MACHINE ?= "cl-som-imx7_defconfig"
UBOOT_MAKE_TARGET = "all"
UBOOT_SUFFIX = "img"
SPL_BINARY = "SPL"

KERNEL_DEVICETREE = "imx7d-cl-som-imx7.dtb imx7d-sbc-imx7.dtb imx7d-sbc-iot-imx7.dtb"

MACHINE_FEATURES += "alsa bluetooth serial usbhost wifi pci"

SERIAL_CONSOLE = "115200 ttymxc0"

XSERVER += "mesa-driver-swrast"

MACHINE_ESSENTIAL_EXTRA_RDEPENDS += " \
    kernel-image \
    kernel-devicetree \
"

MACHINE_FIRMWARE += " \
	linux-firmware-wl18xx \
	linux-firmware-iwlwifi-6000g2a-5 \
	linux-firmware-iwlwifi-6000g2a-6 \
	linux-firmware-iwlwifi-6000g2b-5 \
	linux-firmware-iwlwifi-6000g2b-6 \
"

SOC_DEFAULT_WKS_FILE = "cl-som-imx7.wks"
IMAGE_FSTYPES += "tar.xz"
```

## meta-lmp-base/conf/distro/include/arm-defaults.inc
```bitbake
# This function changes the default tune for machines which
# are based on armv7a or armv7ve to use common tune value, note
# that we enforce hard-float which is default on Linux microPlatform.
# If you have one of those machines which are armv7a or armv7ve but
# can't support hard-float, please change tune = 'armv7athf' to
# tune = 'armv7at' below but then this is for your own distro.

def arm_tune_handler(d):
    features = d.getVar('TUNE_FEATURES').split()
    if 'armv7a' in features or 'armv7ve' in features:
        tune = 'armv7athf'
        if 'bigendian' in features:
            tune += 'b'
        if 'vfpv3' in features:
            tune += '-vfpv3'
        if 'vfpv3d16' in features:
            tune += '-vfpv3d16'
        if 'neon' in features:
            tune += '-neon'
        if 'vfpv4' in features:
            tune += '-vfpv4'
    else:
        tune = d.getVar('DEFAULTTUNE')
    return tune

DEFAULTTUNE_lmp := "${@arm_tune_handler(d)}"
```

## meta-lmp-base/conf/distro/include/lmp.inc
```bitbake
DISTRO_VERSION = "5.1.3"

# These default to 'oecore' and 'nodistro'
SDK_NAME_PREFIX = "${DISTRO}"
SDK_VERSION = "${DISTRO_VERSION}"

MAINTAINER = "LMP Support <support@foundries.io>"

TARGET_VENDOR = "-lmp"

LMP_FACTORY ?= "lmp"
SPDX_ORG = "Foundries.IO (factory ${LMP_FACTORY})"

require conf/distro/include/arm-defaults.inc
require conf/distro/include/non-clangable.inc
require conf/distro/include/security_flags.inc
require conf/distro/include/yocto-uninative.inc
include conf/distro/include/cve-extra-exclusions.inc
include conf/distro/include/cve-lmp-extra-exclusions.inc

# Default CVE check options
CVE_CHECK_REPORT_PATCHED ?= "0"
CVE_CHECK_SKIP_RECIPE ?= "qemu-native qemu-system-native"

# Include distro features in pre-build configuration output
BUILDCFG_VARS += "DISTRO_FEATURES"

PREFERRED_PROVIDER_virtual/kernel ?= "linux-lmp"
PREFERRED_PROVIDER_virtual/optee-os ?= "optee-os-fio"
PREFERRED_PROVIDER_u-boot-fw-utils ?= "libubootenv"
PREFERRED_RPROVIDER_u-boot-fw-utils ?= "libubootenv"
PREFERRED_PROVIDER_zlib ?= "zlib"
PREFERRED_PROVIDER_zlib-native ?= "zlib-native"
PREFERRED_PROVIDER_nativesdk-zlib ?= "nativesdk-zlib"
PREFERRED_PROVIDER_qemu-native ?= "qemu-native"
PREFERRED_PROVIDER_qemu-helper-native ?= "qemu-helper-native"
PREFERRED_PROVIDER_nativesdk-qemu ?= "nativesdk-qemu"

PREFERRED_VERSION_gcc-arm-none-eabi ?= "11"
PREFERRED_VERSION_gcc-arm-none-eabi-native ?= "11"

# Default distro features for LMP (can be extended by the user if needed)
INIT_MANAGER = "systemd"
DISTRO_FEATURES_DEFAULT = "acl argp bluetooth ext2 ipv4 ipv6 largefile usbgadget usbhost wifi xattr zeroconf pci vfat modsign efi security tpm integrity seccomp"
DISTRO_FEATURES_BACKFILL_CONSIDERED = "pulseaudio ldconfig"
DISTRO_FEATURES:append = " pam usrmerge virtualization alsa pni-names"

# List of distro-specific packages to add to all images with packagegroup-distro-base
DISTRO_EXTRA_RRECOMMENDS += "base-files-issue"

# Default IMA policy (tcb)
IMA_POLICY ?= "ima-policy-tcb"

# Extended packageconfig options for LMP
# Required because of https://github.com/opencontainers/runc/issues/2008
PACKAGECONFIG:remove:pn-runc-opencontainers = "static"
PACKAGECONFIG:append:pn-qemu-native = " libusb"
PACKAGECONFIG:append:pn-networkmanager = " libedit"
PACKAGECONFIG:remove:pn-networkmanager = " readline"
PACKAGECONFIG:append:pn-kmod = " openssl"
PACKAGECONFIG:append:pn-kmod-native = " openssl"
PACKAGECONFIG:remove:pn-cryptsetup = "ssh-token"
PACKAGECONFIG:append:pn-cryptsetup = " luks2"
PACKAGECONFIG:append:pn-cryptsetup-native = " luks2"
PACKAGECONFIG:pn-tpm2-tss = "policy"
PACKAGECONFIG:append:pn-systemd = "${@bb.utils.contains('DISTRO_FEATURES', 'lmpdebug', ' coredump', '', d)}"

# Alternatives used by nss-altfiles
NSS_ALT_TYPES ?= "hosts,pwd,grp,spwd,sgrp"
# Unix users that will be mirrored in /etc/passwd to allow manipulation
ETC_PASSWD_MEMBERS ?= "${LMP_USER}"
# Unix groups that will be mirrored in /etc/group to allow manipulation
ETC_GROUP_MEMBERS ?= "sudo audio video plugdev users docker"

# Use staticids for deterministic uid/gid values
USERADDEXTENSION = "useradd-staticids"
USERADD_UID_TABLES = "files/lmp-passwd-table files/lmp-passwd-table-default"
USERADD_GID_TABLES = "files/lmp-group-table files/lmp-group-table-default"
USERADD_ERROR_DYNAMIC = "error"

# Default image formats
IMAGE_FSTYPES += "wic wic.gz wic.bmap"
IMAGE_FSTYPES += "${@bb.utils.contains('DISTRO_FEATURES', 'sota', 'ota-ext4.gz', ' ', d)}"
IMAGE_FSTYPES:remove = "tar.gz tar.xz tar.bz2 wic.xz wic.bz2"

# Default image suffix name
IMAGE_NAME_SUFFIX = ""

# No Ostree tarball by default (prefer ota instead)
BUILD_OSTREE_TARBALL ?= "0"

# LMP default classes and overwrites
INHERIT += "lmp"
INHERIT += "lmp-signing"
INHERIT += "lmp-staging"
INHERIT += "uninative"

# Clang toolchain
TOOLCHAIN ?= "clang"
RUNTIME = "llvm"
# use llvm provided by clang
# https://github.com/kraj/meta-clang/pull/799/files
PREFERRED_PROVIDER_llvm = "clang"
PREFERRED_PROVIDER_llvm-native = "clang-native"
PREFERRED_PROVIDER_nativesdk-llvm = "nativesdk-clang"
PROVIDES:pn-clang = "llvm"
PROVIDES:pn-clang-native = "llvm-native"
PROVIDES:pn-nativesdk-clang = "nativesdk-llvm"

PREMIRRORS += "\
     git://.*/.* https://storage.googleapis.com/lmp-cache/downloads/ \n \
     ftp://.*/.* https://storage.googleapis.com/lmp-cache/downloads/ \n \
     http://.*/.* https://storage.googleapis.com/lmp-cache/downloads/ \n \
     https://.*/.* https://storage.googleapis.com/lmp-cache/downloads/ \n \
"

MIRRORS =+ "\
     git://.*/.* https://storage.googleapis.com/lmp-cache/downloads/ \n \
     ftp://.*/.* https://storage.googleapis.com/lmp-cache/downloads/ \n \
     http://.*/.* https://storage.googleapis.com/lmp-cache/downloads/ \n \
     https://.*/.* https://storage.googleapis.com/lmp-cache/downloads/ \n \
"

# Compatibility with other layers
BBMASK += " \
    /meta-virtualization/recipes-kernel/linux/linux-%.bbappend \
    /meta-security/meta-integrity/recipes-core/systemd/systemd_%.bbappend \
"

# QA check settings - follow poky, which is stricter than the OE-Core defaults
WARN_TO_ERROR_QA = "already-stripped compile-host-path install-host-path \
                    installed-vs-shipped ldflags pn-overrides rpaths staticdev \
                    unknown-configure-option useless-rpaths"
WARN_QA:remove = "${WARN_TO_ERROR_QA}"
ERROR_QA:append = " ${WARN_TO_ERROR_QA}"
ERROR_QA:remove = "version-going-backwards"

# Required to avoid removing libraries used during signing
RM_WORK_EXCLUDE += "make-mod-scripts"

# changing the default user also requires overriding the below files with the same user and group
# in some other layer with higth priority
#  files/lmp-passwd-table-default
#  files/lmp-group-table-default
LMP_USER ?= "fio"

# LMP_PASSWORD is a hassed password. To generate the hash use the following command on a host machine
# that will take care to escape the $ character:
#  echo "LMP_PASSWORD = \"$(mkpasswd -m sha512crypt mysecretpass | sed 's:\$:\\$:g')\""
LMP_PASSWORD ?= "\$6\$OxIhuUvtdFqmUyLv\$gnwD.Qz53y.hvkLc5LyClP8MSRMtG8VZHz.qg/OvRep93ls.2CGzYvINCOrdXYU4yi1q394gWXqixRxO9yCSU/"
```
