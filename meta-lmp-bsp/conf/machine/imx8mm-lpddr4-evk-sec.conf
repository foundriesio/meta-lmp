## meta-lmp-bsp/recipes-kernel/linux/linux-lmp-lts/corstone700/defconfig
```kconfig
# CONFIG_LOCALVERSION_AUTO is not set
# CONFIG_IKCONFIG=y
# CONFIG_IKCONFIG_PROC=y
CONFIG_LOG_BUF_SHIFT=12
CONFIG_BLK_DEV_INITRD=y
# CONFIG_PROFILING=y
# CONFIG_OPROFILE=y
# CONFIG_MODULE_UNLOAD=y
# CONFIG_LBDAF is not set
# CONFIG_IOSCHED_DEADLINE is not set
# CONFIG_IOSCHED_CFQ is not set
CONFIG_ARCH_TINY_VEXPRESS=y
CONFIG_ARM_SINGLE_ARMV7A=y
#CONFIG_DRAM_BASE=0x02100000
CONFIG_PHYS_OFFSET=0x80000000
CONFIG_FLASH_MEM_BASE=0x08000000
CONFIG_FLASH_SIZE=0x4000000
CONFIG_XIP_KERNEL=y
CONFIG_XIP_PHYS_ADDR=0x08300000
# CONFIG_ARCH_VEXPRESS_CA9X4=y
# CONFIG_ARCH_VEXPRESS_DCSCB=y
# CONFIG_ARCH_VEXPRESS_TC2_PM=y
# CONFIG_SWP_EMULATE is not set
# CONFIG_SMP=y
CONFIG_HAVE_ARM_ARCH_TIMER=y
# CONFIG_MCPM=y
# CONFIG_VMSPLIT_2G=y
# CONFIG_NR_CPUS=8
# CONFIG_ARM_PSCI=y
# CONFIG_AEABI=y
# CONFIG_CMA=y
CONFIG_ZBOOT_ROM_TEXT=0x0
CONFIG_ZBOOT_ROM_BSS=0x0
CONFIG_CMDLINE="console=ttyAMA0"
# CONFIG_CPU_IDLE=y
# CONFIG_CPU_IDLE_MULTIPLE_DRIVERS=y
CONFIG_VFP=y
# CONFIG_NEON=y
# CONFIG_CORE_DUMP_DEFAULT_ELF_HEADERS is not set
CONFIG_NET=y
CONFIG_PACKET=y
CONFIG_UNIX=y
CONFIG_INET=y
CONFIG_IP_PNP=y
CONFIG_IP_PNP_DHCP=y
CONFIG_IP_PNP_BOOTP=y
# CONFIG_INET_LRO is not set
# CONFIG_WIRELESS is not set
# CONFIG_NET_9P=y
# CONFIG_NET_9P_VIRTIO=y
# CONFIG_UEVENT_HELPER_PATH="/sbin/hotplug"
CONFIG_DEVTMPFS=y
CONFIG_DEVTMPFS_MOUNT=y
# CONFIG_MTD=y
# CONFIG_MTD_CMDLINE_PARTS=y
# CONFIG_MTD_BLOCK=y
# CONFIG_MTD_CFI=y
# CONFIG_MTD_CFI_INTELEXT=y
# CONFIG_MTD_CFI_AMDSTD=y
# CONFIG_MTD_PHYSMAP=y
# CONFIG_MTD_PHYSMAP_OF=y
# CONFIG_MTD_PLATRAM=y
# CONFIG_MTD_UBI=y
# CONFIG_PROC_DEVICETREE=y
# CONFIG_VIRTIO_BLK=y
# CONFIG_SCSI_PROC_FS is not set
# CONFIG_SCSI_VIRTIO=y
# CONFIG_ATA=y
# CONFIG_SATA_PMP is not set
CONFIG_NETDEVICES=y
CONFIG_VIRTIO_NET=y
CONFIG_SMSC911X=y
# CONFIG_WLAN is not set
# CONFIG_INPUT_EVDEV=y
# CONFIG_SERIO_SERPORT is not set
# CONFIG_SERIO_AMBAKMI=y
# CONFIG_LEGACY_PTY_COUNT=16
CONFIG_SERIAL_AMBA_PL011=y
CONFIG_SERIAL_AMBA_PL011_CONSOLE=y
# CONFIG_VIRTIO_CONSOLE=y
# CONFIG_HW_RANDOM=y
# CONFIG_HW_RANDOM_VIRTIO=y
# CONFIG_I2C=y
# CONFIG_I2C_VERSATILE=y
# CONFIG_SENSORS_VEXPRESS=y
# CONFIG_REGULATOR=y
# CONFIG_REGULATOR_VEXPRESS=y
# CONFIG_FB=y
# CONFIG_FB_ARMCLCD=y
# CONFIG_FRAMEBUFFER_CONSOLE=y
# CONFIG_LOGO=y
# CONFIG_LOGO_LINUX_MONO is not set
# CONFIG_LOGO_LINUX_VGA16 is not set
# CONFIG_SOUND=y
# CONFIG_SND=y
# CONFIG_SND_MIXER_OSS=y
# CONFIG_SND_PCM_OSS=y
# CONFIG_SND_DRIVERS is not set
# CONFIG_SND_ARMAACI=y
# CONFIG_HID_DRAGONRISE=y
# CONFIG_HID_GYRATION=y
# CONFIG_HID_TWINHAN=y
# CONFIG_HID_NTRIG=y
# CONFIG_HID_PANTHERLORD=y
# CONFIG_HID_PETALYNX=y
# CONFIG_HID_SAMSUNG=y
# CONFIG_HID_SONY=y
# CONFIG_HID_SUNPLUS=y
# CONFIG_HID_GREENASIA=y
# CONFIG_HID_SMARTJOYPLUS=y
# CONFIG_HID_TOPSEED=y
# CONFIG_HID_THRUSTMASTER=y
# CONFIG_HID_ZEROPLUS=y
CONFIG_USB=y
CONFIG_USB_ANNOUNCE_NEW_DEVICES=y
CONFIG_USB_MON=y
CONFIG_USB_STORAGE=y
CONFIG_USB_ISP1763=y
# CONFIG_MMC=y
# CONFIG_MMC_ARMMMCI=y
# CONFIG_NEW_LEDS=y
# CONFIG_LEDS_CLASS=y
# CONFIG_LEDS_GPIO=y
# CONFIG_LEDS_TRIGGERS=y
# CONFIG_LEDS_TRIGGER_HEARTBEAT=y
# CONFIG_LEDS_TRIGGER_CPU=y
CONFIG_RTC_CLASS=y
CONFIG_RTC_DRV_PL031=y
# CONFIG_VIRTIO_BALLOON=y
# CONFIG_VIRTIO_MMIO=y
# CONFIG_VIRTIO_MMIO_CMDLINE_DEVICES=y
# CONFIG_EXT2_FS=y
# CONFIG_EXT3_FS=y
# CONFIG_EXT3_DEFAULTS_TO_ORDERED is not set
# CONFIG_EXT3_FS_XATTR is not set
CONFIG_EXT4_FS=y
# CONFIG_VFAT_FS=y
CONFIG_TMPFS=y
# CONFIG_JFFS2_FS=y
# CONFIG_UBIFS_FS=y
# CONFIG_CRAMFS=y
# CONFIG_SQUASHFS=y
# CONFIG_SQUASHFS_LZO=y
# CONFIG_NFS_FS=y
# CONFIG_ROOT_NFS=y
# CONFIG_9P_FS=y
# CONFIG_NLS_CODEPAGE_437=y
# CONFIG_NLS_ISO8859_1=y
# CONFIG_DEBUG_INFO=y
# CONFIG_DEBUG_FS=y
# CONFIG_MAGIC_SYSRQ=y
# CONFIG_DEBUG_KERNEL=y
# CONFIG_DETECT_HUNG_TASK=y
# CONFIG_SCHED_DEBUG is not set
# CONFIG_DEBUG_USER=y
# CONFIG_CRYPTO_ANSI_CPRNG is not set
# CONFIG_CRYPTO_HW is not set
# CONFIG_LTO_MENU=y
CONFIG_THUMB2_KERNEL=y
CONFIG_MAILBOX=y
CONFIG_ARM_MHUv2=y
CONFIG_RPMSG=y
CONFIG_RPMSG_CHAR=y
CONFIG_RPMSG_ARM=y
CONFIG_EXTSYS_CTRL=y
CONFIG_PRINTK_TIME=y
CONFIG_SCSI=y
CONFIG_SCSI_SCAN_ASYNC=y
CONFIG_BLK_DEV_SD=y
CONFIG_CGROUPS=y
CONFIG_CGROUP_FREEZER=y
CONFIG_CGROUP_DEVICE=y
CONFIG_CPUSETS=y
CONFIG_PROC_PID_CPUSET=y
CONFIG_CGROUP_CPUACCT=y
CONFIG_CGROUP_PIDS=y
CONFIG_CGROUP_NET_PRIO=y
CONFIG_CGROUP_PERF=y
CONFIG_CGROUP_BPF=y
CONFIG_MEMCG=y
CONFIG_MEMCG_SWAP=y
CONFIG_CGROUP_SCHED=y
CONFIG_FAIR_GROUP_SCHED=y
# CONFIG_RT_GROUP_SCHED is not set
CONFIG_BLK_CGROUP=y
# CONFIG_BFQ_CGROUP_DEBUG is not set
CONFIG_NAMESPACES=y
CONFIG_UTS_NS=y
CONFIG_IPC_NS=y
CONFIG_USER_NS=y
CONFIG_PID_NS=y
CONFIG_NET_NS=y
CONFIG_FREEZER=y
CONFIG_FHANDLE=y
CONFIG_INOTIFY_USER=y
CONFIG_SIGNALFD=y
CONFIG_TIMERFD=y
CONFIG_CRYPTO_USER=y
CONFIG_CRYPTO_USER_API_HASH=y
CONFIG_CRYPTO_USER_API_AEAD=y
CONFIG_CRYPTO_USER_API_RNG=y
CONFIG_CRYPTO_USER_API_SKCIPHER=y
CONFIG_CRYPTO_HMAC=y
CONFIG_CRYPTO_SHA256=y
CONFIG_DMIID=y
CONFIG_BLK_DEV_BSG=y
CONFIG_SECCOMP=y
CONFIG_SECCOMP_FILTER=y
CONFIG_CHECKPOINT_RESTORE=y
CONFIG_CFS_BANDWIDTH=y
CONFIG_AUTOFS4_FS=y
CONFIG_SYSVIPC=y
CONFIG_POSIX_MQUEUE=y
CONFIG_BSD_PROCESS_ACCT=y
CONFIG_BSD_PROCESS_ACCT_V3=y
# CONFIG_PREEMPT_NONE is not set
CONFIG_PREEMPT_VOLUNTARY=y
CONFIG_XFRM=y
CONFIG_BPF_SYSCALL=y
CONFIG_HUGETLB_PAGE=y
CONFIG_HUGETLBFS=y
CONFIG_FUSE_FS=y
CONFIG_CONFIGFS_FS=y
CONFIG_BLK_DEV_THROTTLING=y
CONFIG_CFQ_GROUP_IOSCHED=y
CONFIG_BLK_CGROUP_IOLATENCY=y
CONFIG_BLK_CGROUP_IOCOST=y
CONFIG_IPV6=y
CONFIG_TMPFS_XATTR=y
CONFIG_TMPFS_POSIX_ACL=y
CONFIG_EXT4_FS_POSIX_ACL=y
CONFIG_WIREGUARD=y
```
