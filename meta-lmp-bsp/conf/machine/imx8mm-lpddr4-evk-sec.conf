## meta-lmp-bsp/conf/machine/imx8mm-lpddr4-evk-sec.conf
```bitbake
#@TYPE: Machine
#@NAME: NXP i.MX 8M Mini EVK with LPDDR4 Secure
#@SOC: i.MX8MM
#@DESCRIPTION: Machine configuration for NXP i.MX 8M Mini Evaluation Kit with LPDDR4
#              with secure boot enabled by default
#@MAINTAINER: Vanessa Maegima <vanessa.maegima@foundries.io>

require conf/machine/imx8mm-lpddr4-evk.conf

KMACHINE = "imx8mmevk"
MACHINEOVERRIDES .= ":imx8mm-lpddr4-evk:imx8mm-lpddr4-evk-sec"
```

## meta-lmp-bsp/conf/machine/imx8mmevk.conf
```bitbake
#@TYPE: Machine
#@NAME: NXP i.MX 8M Mini EVK with LPDDR4
#@SOC: i.MX8MM
#@DESCRIPTION: Machine configuration for NXP i.MX 8M Mini Evaluation Kit with LPDDR4
#              Done as a transition to the new machine names available in hardknott.
#@MAINTAINER: Ricardo Salveti <ricardo@foundries.io>

require conf/machine/imx8mm-lpddr4-evk.conf

MACHINEOVERRIDES .= ":imx8mm-lpddr4-evk"
```

## meta-lmp-bsp/conf/machine/imx8mn-ddr4-evk-sec.conf
```bitbake
#@TYPE: Machine
#@NAME: NXP i.MX 8M Nano EVK with DDR4 Secure
#@SOC: i.MX8MN
#@DESCRIPTION: Machine configuration for NXP i.MX 8M Nano Evaluation Kit with DDR4
#              with secure boot enabled by default

MACHINEOVERRIDES =. "imx8mn-ddr4-evk:"

require conf/machine/imx8mn-ddr4-evk.conf

KMACHINE = "imx8mn-evk"

MACHINE_FEATURES += "fiovb"

KERNEL_DEVICETREE_BASENAME = "imx8mn-ddr4-evk"
```

## meta-lmp-bsp/conf/machine/imx8mn-lpddr4-evk-sec.conf
```bitbake
#@TYPE: Machine
#@NAME: NXP i.MX 8M Nano EVK with LPDDR4 Secure
#@SOC: i.MX8MN
#@DESCRIPTION: Machine configuration for NXP i.MX 8M Nano Evaluation Kit with LPDDR4
#              with secure boot enabled by default

MACHINEOVERRIDES =. "imx8mn-lpddr4-evk:"

require conf/machine/imx8mn-lpddr4-evk.conf

KMACHINE = "imx8mn-evk"

MACHINE_FEATURES += "fiovb"

KERNEL_DEVICETREE_BASENAME = "imx8mn-evk"
```

## meta-lmp-bsp/conf/machine/imx8mp-lpddr4-evk-ebbr.conf
```bitbake
#@TYPE: Machine
#@NAME: NXP i.MX 8M Plus EVK with LPDDR4 and EBBR
#@SOC: i.MX8MP
#@DESCRIPTION: Machine configuration for NXP i.MX 8M Plus Evaluation Kit with LPDDR4
#              following the EBBR requirements (UEFI)

require conf/machine/imx8mp-lpddr4-evk.conf

KMACHINE = "imx8mp-lpddr4-evk"
MACHINE_FEATURES += "efi ebbr"
MACHINEOVERRIDES .= ":imx8mp-lpddr4-evk:imx8mp-lpddr4-evk-ebbr"
```

## meta-lmp-bsp/conf/machine/imx8mp-lpddr4-evk-sec.conf
```bitbake
#@TYPE: Machine
#@NAME: NXP i.MX 8M Plus EVK with LPDDR4 Secure
#@SOC: i.MX8MP
#@DESCRIPTION: Machine configuration for NXP i.MX 8M Plus Evaluation Kit with LPDDR4
#              with secure boot enabled by default

MACHINEOVERRIDES =. "imx8mp-lpddr4-evk:"

require conf/machine/imx8mp-lpddr4-evk.conf

KMACHINE = "imx8mp-lpddr4-evk"

MACHINE_FEATURES += "fiovb"
```

## meta-lmp-bsp/conf/machine/imx8mq-evk-ebbr.conf
```bitbake
#@TYPE: Machine
#@NAME: NXP i.MX 8M Quad EVK with support for EBBR
#@SOC: i.MX8MQ
#@DESCRIPTION: Machine configuration for NXP i.MX 8M Quad EVK
#              following the EBBR requirements (UEFI)

MACHINEOVERRIDES =. "imx8mq-evk:"

require conf/machine/imx8mq-evk.conf

KMACHINE = "imx8mqevk"
MACHINE_FEATURES += "efi ebbr"
```

## meta-lmp-bsp/conf/machine/imx8mqevk.conf
```bitbake
#@TYPE: Machine
#@NAME: NXP i.MX 8M Quad EVK
#@SOC: i.MX8MQ
#@DESCRIPTION: Machine configuration for NXP i.MX 8M Quad Evaluation Kit
#              Done as a transition to the new machine names available in hardknott.
#@MAINTAINER: Ricardo Salveti <ricardo@foundries.io>

require conf/machine/imx8mq-evk.conf

MACHINEOVERRIDES .= ":imx8mq-evk"
```

## meta-lmp-bsp/conf/machine/imx8qm-mek-sec.conf
```bitbake
#@TYPE: Machine
#@NAME: NXP i.MX 8QuadMax Multisensory Enablement Kit (MEK) Secure
#@SOC: i.MX8QM
#@DESCRIPTION: Machine configuration for NXP i.MX 8QuadMax MEK with secure
#              boot enabled by default
#@MAINTAINER: Igor Opaniuk <igor.opaniuk@foundries.io>

MACHINEOVERRIDES =. "imx8qm-mek:"

require conf/machine/imx8qm-mek.conf

KMACHINE = "imx8qm-mek"

MACHINE_FEATURES += "fiovb"
```

## meta-lmp-bsp/conf/machine/imx8qm-mek.conf
```bitbake
#@TYPE: Machine
#@NAME: i.MX 8QM MEK
#@DESCRIPTION: i.MX 8QuadMax MEK board
#@MAINTAINER: Igor Opaniuk <igor.opaniuk@foundries.io>

require conf/machine/imx8qm-mek.conf

MACHINEOVERRIDES =. ":imx8qm-mek"
```

## meta-lmp-bsp/conf/machine/include/lmp-machine-custom.inc
```bitbake
# LMP specific configuration

# Beaglebone
PREFERRED_PROVIDER_virtual/bootloader:beaglebone-yocto = "u-boot-fio"
PREFERRED_PROVIDER_u-boot:beaglebone-yocto = "u-boot-fio"
WKS_FILE_DEPENDS:append:beaglebone-yocto = " u-boot-default-script"
PREFERRED_PROVIDER_u-boot-default-script:beaglebone-yocto = "u-boot-ostree-scr-fit"
SOTA_CLIENT_FEATURES:append:beaglebone-yocto = " ubootenv"
OSTREE_KERNEL_ARGS:beaglebone-yocto ?= "console=ttyS0,115200n8 ${OSTREE_KERNEL_ARGS_COMMON}"
DTB_FILES:append:beaglebone-yocto = " am335x-boneblack-wireless.dtb"
IMAGE_BOOT_FILES:beaglebone-yocto = "u-boot.img MLO boot.itb ${KERNEL_IMAGETYPE}"
KERNEL_IMAGETYPE:beaglebone-yocto = "fitImage"
KERNEL_CLASSES:beaglebone-yocto = " kernel-lmp-fitimage "
UBOOT_ENTRYPOINT:beaglebone-yocto = "0x80008000"
UBOOT_LOADADDRESS:beaglebone-yocto = "0x80008000"
## beaglebone-yocto.conf appends kernel-image-zimage by default
IMAGE_INSTALL:remove:beaglebone-yocto = "kernel-image-zimage"

# Raspberry Pi
PREFERRED_PROVIDER_virtual/kernel:rpi ?= "linux-lmp-rpi"
PREFERRED_PROVIDER_virtual/bootloader:rpi = "u-boot-fio"
PREFERRED_PROVIDER_u-boot:rpi = "u-boot-fio"
SOTA_CLIENT_FEATURES:append:rpi = " ubootenv"
WKS_FILE_DEPENDS_BOOTLOADERS:rpi = "virtual/bootloader"
WKS_FILE_DEPENDS:append:rpi = " u-boot-default-script"
PREFERRED_PROVIDER_u-boot-default-script:rpi = "u-boot-ostree-scr"
PREFERRED_PROVIDER_u-boot-default-script:sota:rpi = "u-boot-ostree-scr-fit"
PREFERRED_PROVIDER_virtual/dtb:rpi ?= "lmp-device-tree"
IMAGE_FSTYPES:remove:rpi = "ext3 rpi-sdimg"
IMAGE_BOOT_FILES:rpi = "${BOOTFILES_DIR_NAME}/* u-boot.bin;${SDIMG_KERNELIMAGE} ${KERNEL_IMAGETYPE} ${@make_dtb_boot_files(d)} boot.scr uEnv.txt"
IMAGE_BOOT_FILES:sota:rpi = "${BOOTFILES_DIR_NAME}/* u-boot.bin;${SDIMG_KERNELIMAGE} ${@make_dtb_boot_files(d)} boot.itb"
KERNEL_CLASSES:sota:rpi = " kernel-lmp-fitimage "
KERNEL_IMAGETYPE:sota:rpi = "fitImage"
## Workaround for https://github.com/raspberrypi/firmware/issues/1483
ENABLE_UART:rpi = "1"
## Mimic meta-raspberrypi behavior
KERNEL_SERIAL:rpi ?= "${@oe.utils.conditional("ENABLE_UART", "1", "console=ttyS0,115200", "", d)}"
KERNEL_SERIAL:raspberrypi5 ?= "console=ttyAMA10,115200"
OSTREE_KERNEL_ARGS_COMMON_RPI ?= "coherent_pool=1M 8250.nr_uarts=1 console=tty1 cgroup_enable=memory ${KERNEL_SERIAL} ${OSTREE_KERNEL_ARGS_COMMON}"
OSTREE_KERNEL_ARGS:raspberrypi4 ?= "vc_mem.mem_base=0x3ec00000 vc_mem.mem_size=0x40000000 ${OSTREE_KERNEL_ARGS_COMMON_RPI}"
OSTREE_KERNEL_ARGS:raspberrypi5 ?= "pci=pcie_bus_safe vc_mem.mem_base=0x3fc00000 vc_mem.mem_size=0x40000000 ${OSTREE_KERNEL_ARGS_COMMON_RPI}"
## U-Boot entrypoints for rpi
UBOOT_ENTRYPOINT:rpi = "0x00200000"
UBOOT_DTB_LOADADDRESS:rpi = "0x02600000"
UBOOT_DTBO_LOADADDRESS:rpi = "0x026d0000"
## Rpi 4/CM4
MACHINE_EXTRA_RRECOMMENDS:append:raspberrypi4 = " linux-firmware-rpidistro-bcm43456"

# QEMU ARM
PREFERRED_PROVIDER_virtual/bootloader:qemuarm64 = "u-boot-fio"
PREFERRED_PROVIDER_u-boot:qemuarm64 = "u-boot-fio"
WKS_FILE_DEPENDS:append:qemuarm64 = " u-boot-default-script"
PREFERRED_PROVIDER_u-boot-default-script:qemuarm64 = "u-boot-ostree-scr-fit"
SOTA_CLIENT_FEATURES:append:qemuarm64 = " ubootenv"
IMAGE_BOOT_FILES:qemuarm64 = "boot.itb"
KERNEL_IMAGETYPE:qemuarm64 = "fitImage"
KERNEL_CLASSES:qemuarm64 = " kernel-lmp-fitimage "
OSTREE_KERNEL_ARGS:qemuarm64 ?= "console=ttyAMA0 ${OSTREE_KERNEL_ARGS_COMMON}"
UBOOT_ENTRYPOINT:qemuarm64 = "0x40080000"
MACHINE_FEATURES:append:qemuarm64-secureboot = " optee"
OSTREE_SPLIT_BOOT:qemuarm64-secureboot = "1"
OSTREE_DEPLOY_USR_OSTREE_BOOT:qemuarm64-secureboot = "1"
INITRAMFS_RECOVERY_IMAGE:qemuarm64-secureboot = "initramfs-ostree-lmp-recovery"
WKS_FILE:sota:qemuarm64-secureboot = "sdimage-split-boot-sota.wks.in"
## Use same minimal memory amount as suggested by op-tee
QB_MEM:qemuarm64-secureboot = "-m 1057"
QB_DRIVE_TYPE:qemuarm64-secureboot = "/dev/vdb"
## EBBR / SystemReady
WKS_FILE_DEPENDS:remove:qemuarm64-secureboot-ebbr = "u-boot-default-script"
PREFERRED_PROVIDER_virtual/bootloader:qemuarm64-secureboot-ebbr = "edk2-firmware"
SOTA_CLIENT_FEATURES:remove:qemuarm64-secureboot-ebbr = "ubootenv"
KERNEL_IMAGETYPE:qemuarm64-secureboot-ebbr ?= "Image"
KERNEL_CLASSES:qemuarm64-secureboot-ebbr ?= ""
EFI_PROVIDER:qemuarm64-secureboot-ebbr ?= "grub-efi"
OSTREE_SPLIT_BOOT:qemuarm64-secureboot-ebbr = "0"
OSTREE_LOADER_LINK:qemuarm64-secureboot-ebbr = "1"
OSTREE_BOOTLOADER:qemuarm64-secureboot-ebbr ?= "grub"
OSTREE_KERNEL_ARGS:qemuarm64-secureboot-ebbr ?= "${OSTREE_KERNEL_ARGS_COMMON}"
IMAGE_BOOT_FILES:qemuarm64-secureboot-ebbr = ""
WKS_FILE:qemuarm64-secureboot-ebbr:sota ?= "efidisk-sota.wks.in"
QB_MACHINE:qemuarm64-secureboot-ebbr = "-machine virt"
QB_DRIVE_TYPE:qemuarm64-secureboot-ebbr = "/dev/hd"
QB_DEFAULT_KERNEL:qemuarm64-secureboot-ebbr = "none"
QB_OPT_APPEND:append:qemuarm64-secureboot-ebbr = " -drive file=@DEPLOY_DIR_IMAGE@/QEMU_EFI.fd,format=raw,if=pflash,readonly=on -drive file=@DEPLOY_DIR_IMAGE@/QEMU_VARS.fd,format=raw,if=pflash"
QB_OPT_APPEND:remove:qemuarm64-secureboot-ebbr = "-no-acpi"
QB_DEFAULT_BIOS:qemuarm64-secureboot-ebbr = ""

# QEMU ARM
PREFERRED_PROVIDER_virtual/bootloader:qemuarm = "u-boot-fio"
PREFERRED_PROVIDER_u-boot:qemuarm = "u-boot-fio"
WKS_FILE_DEPENDS:append:qemuarm = " u-boot-default-script"
PREFERRED_PROVIDER_u-boot-default-script:qemuarm = "u-boot-ostree-scr-fit"
SOTA_CLIENT_FEATURES:append:qemuarm = " ubootenv"
IMAGE_BOOT_FILES:qemuarm = "boot.itb"
KERNEL_IMAGETYPE:qemuarm = "fitImage"
KERNEL_CLASSES:qemuarm = " kernel-lmp-fitimage "
OSTREE_KERNEL_ARGS:qemuarm ?= "console=ttyAMA0 ${OSTREE_KERNEL_ARGS_COMMON}"
UBOOT_ENTRYPOINT:qemuarm = "0x40080000"
QB_DRIVE_TYPE:qemuarm = "/dev/vdb"
## Currently support u-boot -> Linux boot
## will add more security later
QB_OPT_APPEND:qemuarm = "-no-acpi -bios ${DEPLOY_DIR_IMAGE}/u-boot.bin -d unimp"

# ARM64 Generic (SystemReady)
OSTREE_BOOTLOADER:generic-arm64 ?= "none"
OSTREE_KERNEL_ARGS:generic-arm64 ?= "console=ttyAMA0,115200 ${OSTREE_KERNEL_ARGS_COMMON}"
MACHINE_FEATURES:append:generic-arm64 = " acpi pci usbhost tpm2"
UEFI_SIGN_ENABLE:generic-arm64 = "1"
EFI_PROVIDER:generic-arm64 ?= "systemd-boot"
OSTREE_SPLIT_BOOT:generic-arm64 = "1"
OSTREE_LOADER_LINK:generic-arm64 = "0"
KERNEL_CLASSES:generic-arm64 = " kernel-lmp-efi "
WKS_FILE:generic-arm64:sota ?= "efidisk-sota.wks.in"
WKS_FILE_DEPENDS:append:generic-arm64 = " ${INITRD_IMAGE_LIVE}"
## wic-based installer requires image to be available via IMAGE_BOOT_FILES
IMAGE_BOOT_FILES:generic-arm64 = "${@bb.utils.contains('WKS_FILE', 'image-efi-installer.wks.in', 'systemd-bootaa64.efi;EFI/BOOT/bootaa64.efi systemd-bootaa64.efi;EFI/systemd/systemd-bootaa64.efi ${IMGDEPLOYDIR}/${IMAGE_BASENAME}-${MACHINE}.ota-ext4;rootfs.img', '', d)}"
IMAGE_EFI_BOOT_FILES:append:generic-arm64 = "${@bb.utils.contains('UEFI_SIGN_ENABLE', '1', '${@make_efi_cer_boot_files(d)} ', '', d)}"

# Intel
MACHINE_EXTRA_RRECOMMENDS:remove:intel-corei7-64 = "linux-firmware"
MACHINE_FEATURES:append:intel-corei7-64 = " tpm2"
UEFI_SIGN_ENABLE:intel-corei7-64 = "1"
OSTREE_BOOTLOADER:intel-corei7-64 ?= "none"
OSTREE_KERNEL_ARGS:intel-corei7-64 ?= "console=ttyS0,115200 ${OSTREE_KERNEL_ARGS_COMMON}"
EFI_PROVIDER:intel-corei7-64 = "systemd-boot"
OSTREE_SPLIT_BOOT:intel-corei7-64 = "1"
OSTREE_LOADER_LINK:intel-corei7-64 = "0"
KERNEL_CLASSES:intel-corei7-64 = " kernel-lmp-efi "
WKS_FILE:intel-corei7-64:sota ?= "efidisk-sota.wks.in"
WKS_FILE_DEPENDS:append:intel-corei7-64 = " ${INITRD_IMAGE_LIVE} efitools"
WKS_FILE_DEPENDS_BOOTLOADERS:remove:intel-corei7-64 = "grub-efi"
## wic-based installer requires image to be available via IMAGE_BOOT_FILES
IMAGE_BOOT_FILES:intel-corei7-64 = "${@bb.utils.contains('WKS_FILE', 'image-efi-installer.wks.in', 'systemd-bootx64.efi;EFI/BOOT/bootx64.efi systemd-bootx64.efi;EFI/systemd/systemd-bootx64.efi ${IMGDEPLOYDIR}/${IMAGE_BASENAME}-${MACHINE}.ota-ext4;rootfs.img', '', d)}"
IMAGE_EFI_BOOT_FILES:append:intel-corei7-64 = "${@bb.utils.contains('UEFI_SIGN_ENABLE', '1', ' lockdown.conf;loader/entries/doprovision_lock+0.conf unlock.conf;loader/entries/doprovision_unlock+0.conf LockDown.efi UnLock-signed.efi ${@make_efi_cer_boot_files(d)} ', '', d)}"


# Allwinner (sun8i)
PREFERRED_PROVIDER_virtual/bootloader:sun8i = "u-boot-fio"
PREFERRED_PROVIDER_u-boot:sun8i = "u-boot-fio"
UBOOT_ENTRYPOINT:sun8i = "0x42000000"
WKS_FILE_DEPENDS:append:sun8i = " u-boot-default-script"
PREFERRED_PROVIDER_u-boot-default-script:sun8i = "u-boot-ostree-scr-fit"
IMAGE_BOOT_FILES:sun8i = "boot.itb"
KERNEL_IMAGETYPE:sun8i = "fitImage"
KERNEL_CLASSES:sun8i = " kernel-lmp-fitimage "
WKS_FILES:sota:sun8i = "sdimage-sunxi-sota.wks.in"
IMAGE_FSTYPES:remove:sun8i = "sunxi-sdimg"
SOTA_CLIENT_FEATURES:append:sun8i = " ubootenv"
OSTREE_KERNEL_ARGS:sun8i ?= "earlycon console=ttyS0,115200 ${OSTREE_KERNEL_ARGS_COMMON}"
```
